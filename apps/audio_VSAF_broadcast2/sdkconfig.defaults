## archive/android2node/sdkconfig.defaults
```kconfig
# Target & Flash Configuration
CONFIG_IDF_TARGET="esp32c6"
CONFIG_ESPTOOLPY_FLASHSIZE_8MB=y
CONFIG_ESPTOOLPY_FLASHSIZE="8MB"

# C++ Configuration
CONFIG_COMPILER_CXX_EXCEPTIONS=y
CONFIG_COMPILER_CXX_RTTI=y
CONFIG_COMPILER_STACK_CHECK=y

# Console Output over Onboard USB Serial JTAG (Virtual COM Port)
CONFIG_ESP_CONSOLE_USB_SERIAL_JTAG=y
CONFIG_ESP_CONSOLE_SECONDARY_NONE=y

# FreeRTOS Configuration
CONFIG_FREERTOS_HZ=1000
CONFIG_FREERTOS_INTERRUPT_BACKTRACE=y
CONFIG_FREERTOS_GENERATE_RUN_TIME_STATS=y
CONFIG_FREERTOS_USE_TRACE_FACILITY=y
CONFIG_FREERTOS_USE_STATS_FORMATTING_FUNCTIONS=y

# Bluetooth Subsystem Configuration
CONFIG_BT_ENABLED=y
CONFIG_BT_BLE_50_FEATURES_SUPPORTED=y
CONFIG_BT_BLE_53_FEATURES_SUPPORTED=y
CONFIG_BT_NIMBLE_ENABLED=y
CONFIG_BT_NIMBLE_ROLE_OBSERVER=y
CONFIG_BT_NIMBLE_ROLE_BROADCASTER=y
CONFIG_BT_NIMBLE_ROLE_CENTRAL=y
CONFIG_BT_NIMBLE_ROLE_PERIPHERAL=y

# Wi-Fi 6 Subsystem Configuration
CONFIG_ESP_WIFI_ENABLED=y
CONFIG_ESP_WIFI_SOFTAP_SUPPORT=n

# HTTP/HTTPS OTA Firmware Update Configuration
CONFIG_ESP_HTTPS_OTA_ALLOW_HTTP=y
CONFIG_PARTITION_TABLE_SINGLE_APP=n
CONFIG_PARTITION_TABLE_SINGLE_APP_LARGE=n
CONFIG_PARTITION_TABLE_TWO_OTA=n
CONFIG_PARTITION_TABLE_CUSTOM=y
CONFIG_PARTITION_TABLE_CUSTOM_FILENAME="partitions.csv"
CONFIG_PARTITION_TABLE_FILENAME="partitions.csv"

# ESP System Temperature Sensor
CONFIG_TEMP_SENSOR_ENABLE_DEFAULT_CONVERSION=y
```

## archive/audio_ESP_NOW_broadcast/sdkconfig.defaults
```kconfig
CONFIG_FREERTOS_HZ=1000
CONFIG_PARTITION_TABLE_CUSTOM=y
CONFIG_PARTITION_TABLE_CUSTOM_FILENAME="partitions.csv"


# Wi-Fi & ESP-NOW Enabled
CONFIG_ESP_WIFI_ENABLED=y
CONFIG_ESP_WIFI_STATIC_RX_BUFFER_NUM=16
CONFIG_ESP_WIFI_DYNAMIC_RX_BUFFER_NUM=32
CONFIG_ESP_WIFI_STATIC_TX_BUFFER_NUM=16
CONFIG_ESP_WIFI_CACHE_TX_BUFFER_NUM=32
CONFIG_ESP_WIFI_AMPDU_TX_ENABLED=y
CONFIG_ESP_WIFI_TX_BA_WIN=16
CONFIG_ESP_WIFI_AMPDU_RX_ENABLED=y
CONFIG_ESP_WIFI_RX_BA_WIN=16
CONFIG_ESP_WIFI_IRAM_OPT=y
CONFIG_ESP_WIFI_RX_IRAM_OPT=y

# BLUETOOTH COMPLETELY DISABLED
CONFIG_BT_ENABLED=n
# CONFIG_BT_NIMBLE_ENABLED is not set
# CONFIG_BT_BLUEDROID_ENABLED is not set

# Compiler Optimization
CONFIG_COMPILER_OPTIMIZATION_PERF=y

# Console Output: USB-Serial/JTAG (COM21 / COM23 / COM24)
CONFIG_ESP_CONSOLE_USB_SERIAL_JTAG=y
CONFIG_ESP_CONSOLE_SECONDARY_NONE=y

CONFIG_ESP_TASK_WDT_CHECK_IDLE_TASK_CPU0=n
CONFIG_ESP_TASK_WDT_TIMEOUT_S=10

# FreeRTOS Run Time Stats (for 1 Hz CPU Load measurement)
CONFIG_FREERTOS_GENERATE_RUN_TIME_STATS=y
CONFIG_FREERTOS_USE_TRACE_FACILITY=y
CONFIG_FREERTOS_USE_STATS_FORMATTING_FUNCTIONS=y
```

## archive/audio_ESP_NOW_broadcast/sdkconfig.defaults.esp32c6
```kconfig
CONFIG_IDF_TARGET="esp32c6"
CONFIG_ESP_DEFAULT_CPU_FREQ_MHZ_160=y
CONFIG_ESP_DEFAULT_CPU_FREQ_MHZ=160
CONFIG_ESPTOOLPY_FLASHSIZE_8MB=y
CONFIG_ESPTOOLPY_FLASHSIZE="8MB"
CONFIG_ESP_CONSOLE_USB_SERIAL_JTAG=y
CONFIG_ESP_CONSOLE_SECONDARY_NONE=y
```

## archive/audio_ESP_NOW_broadcast/sdkconfig.defaults.esp32s3
```kconfig
CONFIG_IDF_TARGET="esp32s3"
CONFIG_ESP_DEFAULT_CPU_FREQ_MHZ_240=y
CONFIG_ESP_DEFAULT_CPU_FREQ_MHZ=240
CONFIG_ESPTOOLPY_FLASHSIZE_4MB=y
CONFIG_ESPTOOLPY_FLASHSIZE="4MB"
CONFIG_ESP_CONSOLE_USB_SERIAL_JTAG=y
CONFIG_ESP_CONSOLE_SECONDARY_NONE=y
CONFIG_FREERTOS_NUMBER_OF_CORES=2
CONFIG_ESP_WIFI_TASK_PINNED_TO_CORE_0=y
```

## archive/usb_ble_bumble/sdkconfig.defaults
```kconfig
CONFIG_IDF_TARGET="esp32c6"
CONFIG_ESPTOOLPY_FLASHFREQ_40M=y
CONFIG_ESPTOOLPY_FLASHFREQ="40m"
CONFIG_ESPTOOLPY_FLASHMODE_DIO=y
CONFIG_ESPTOOLPY_FLASHMODE="dio"
CONFIG_ESPTOOLPY_FLASHSIZE_4MB=y
CONFIG_ESPTOOLPY_FLASHSIZE="4MB"

# CPU Frequency
CONFIG_ESP_DEFAULT_CPU_FREQ_MHZ_160=y

# FreeRTOS 1000Hz
CONFIG_FREERTOS_HZ=1000

# Disable console logs on UART0 to maintain pure binary H4 protocol
CONFIG_ESP_CONSOLE_NONE=y
CONFIG_ESP_CONSOLE_UART_NUM=-1
CONFIG_BOOTLOADER_LOG_LEVEL_NONE=y
CONFIG_BOOTLOADER_LOG_LEVEL=0
CONFIG_LOG_DEFAULT_LEVEL_NONE=y
CONFIG_LOG_DEFAULT_LEVEL=0

# Bluetooth Controller Configuration with VHCI support
CONFIG_BT_ENABLED=y
CONFIG_BT_CONTROLLER_ENABLED=y
CONFIG_BT_BLUEDROID_ENABLED=y
CONFIG_BTDM_CTRL_MODE_BLE_ONLY=y
CONFIG_BTDM_CTRL_MODE_BR_EDR_ONLY=n
CONFIG_BTDM_CTRL_MODE_BTDM=n

CONFIG_BT_LE_50_FEATURE_SUPPORT=y
CONFIG_BT_LE_EXT_ADV=y
CONFIG_BT_LE_ENABLE_PERIODIC_ADV=y
CONFIG_BT_LE_PERIODIC_ADV_SYNC_TRANSFER=y
CONFIG_BT_LE_MAX_EXT_ADV_INSTANCES=4
CONFIG_BT_LE_EXT_ADV_MAX_SIZE=1650

# BLE Controller buffer sizing
CONFIG_BT_LE_MSYS_1_BLOCK_COUNT=24
CONFIG_BT_LE_MSYS_2_BLOCK_COUNT=48
CONFIG_BT_LE_ACL_BUF_COUNT=40
CONFIG_BT_LE_ACL_BUF_SIZE=517
CONFIG_BT_LE_HCI_EVT_BUF_SIZE=257
CONFIG_BT_LE_HCI_EVT_HI_BUF_COUNT=40
CONFIG_BT_LE_HCI_EVT_LO_BUF_COUNT=16
```

## components/liblc3/Kconfig
```kconfig
menu "liblc3 Codec Configuration"

    config LC3_ENABLE_PLUS_MODES
        bool "Build LC3plus modes (2.5/5 ms frames, 96 kHz high resolution)"
        default n
        help
            liblc3 builds LC3plus (LC3_PLUS) and LC3plus High Resolution (LC3_PLUS_HR) by default. Their
            lookup tables are large and, with LC3_CODE_IN_IRAM, all land in internal SRAM. VSAF2 only uses
            standard LC3 (10 ms, 8-48 kHz); leaving this off saves tens of KB of internal RAM, which the
            PSRAM-less SOURCE (Node 16) needs for its 11 encoder instances and pipeline tasks.

    config LC3_CODE_IN_IRAM
        bool "Place liblc3 codec routines and tables in IRAM"
        default y
        help
            When enabled, liblc3 encoder and decoder code and lookup tables are mapped
            into internal SRAM (IRAM/DRAM) to eliminate SPI flash cache miss latency.

endmenu
```
