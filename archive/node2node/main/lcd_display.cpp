#include "lcd_display.hpp"
#include "status_led.hpp"
#include "esp_log.h"
#include "esp_lcd_panel_io.h"
#include "esp_lcd_panel_vendor.h"
#include "esp_lcd_panel_ops.h"
#include "driver/spi_master.h"
#include "driver/gpio.h"
#include "driver/ledc.h"
#include "led_strip.h"
#include <cstring>
#include <cstdio>

static const char* TAG = "LCD";

namespace Hardware {

static const uint8_t FONT_8X16[96][16] = {
    {0x00,0x00,0x00,0x00,0x00,0x00,0x00,0x00,0x00,0x00,0x00,0x00,0x00,0x00,0x00,0x00}, // ' '
    {0x00,0x00,0x18,0x3C,0x3C,0x3C,0x18,0x18,0x18,0x00,0x18,0x18,0x00,0x00,0x00,0x00}, // '!'
    {0x00,0x66,0x66,0x66,0x24,0x00,0x00,0x00,0x00,0x00,0x00,0x00,0x00,0x00,0x00,0x00}, // '"'
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    {0x00,0x3B,0x6E,0x00,0x00,0x00,0x00,0x00,0x00,0x00,0x00,0x00,0x00,0x00,0x00,0x00}  // '~'
};

LcdDisplay::LcdDisplay() = default;

LcdDisplay::~LcdDisplay() {
    if (m_framebuffer) {
        heap_caps_free(m_framebuffer);
        m_framebuffer = nullptr;
    }
}

esp_err_t LcdDisplay::init() {
    ESP_LOGI(TAG, "Initializing ST7789 1.47-inch LCD (320x172 Landscape)...");

    // 1. Backlight PWM Configuration (20% Brightness to minimize power dissipation)
    ledc_timer_config_t ledc_timer = {};
    ledc_timer.speed_mode = LEDC_LOW_SPEED_MODE;
    ledc_timer.duty_resolution = LEDC_TIMER_10_BIT;
    ledc_timer.timer_num = LEDC_TIMER_0;
    ledc_timer.freq_hz = 5000; // 5 kHz PWM
    ledc_timer.clk_cfg = LEDC_AUTO_CLK;
    ledc_timer_config(&ledc_timer);

    ledc_channel_config_t ledc_channel = {};
    ledc_channel.speed_mode = LEDC_LOW_SPEED_MODE;
    ledc_channel.channel = LEDC_CHANNEL_0;
    ledc_channel.timer_sel = LEDC_TIMER_0;
    // intr_type handled automatically in v6
    ledc_channel.gpio_num = LCD_PIN_BL;
    ledc_channel.duty = 205; // 20% Duty Cycle (205 / 1023)
    ledc_channel.hpoint = 0;
    ledc_channel_config(&ledc_channel);

    // 2. SPI Bus Config
    spi_bus_config_t bus_cfg = {};
    bus_cfg.sclk_io_num = LCD_PIN_SCLK;
    bus_cfg.mosi_io_num = LCD_PIN_MOSI;
    bus_cfg.miso_io_num = -1;
    bus_cfg.quadwp_io_num = -1;
    bus_cfg.quadhd_io_num = -1;
    bus_cfg.max_transfer_sz = LCD_WIDTH * LCD_HEIGHT * sizeof(uint16_t);

    esp_err_t ret = spi_bus_initialize(SPI2_HOST, &bus_cfg, SPI_DMA_CH_AUTO);
    if (ret != ESP_OK && ret != ESP_ERR_INVALID_STATE) {
        ESP_LOGE(TAG, "SPI bus init failed: %s", esp_err_to_name(ret));
        return ret;
    }

    // 3. Panel IO Config
    esp_lcd_panel_io_spi_config_t io_cfg = {};
    io_cfg.dc_gpio_num = LCD_PIN_DC;
    io_cfg.cs_gpio_num = LCD_PIN_CS;
    io_cfg.pclk_hz = 40 * 1000 * 1000; // 40 MHz SPI Clock
    io_cfg.lcd_cmd_bits = 8;
    io_cfg.lcd_param_bits = 8;
    io_cfg.spi_mode = 0;
    io_cfg.trans_queue_depth = 10;

    esp_lcd_panel_io_handle_t io_handle = nullptr;
    ret = esp_lcd_new_panel_io_spi((esp_lcd_spi_bus_handle_t)SPI2_HOST, &io_cfg, &io_handle);
    if (ret != ESP_OK) {
        ESP_LOGE(TAG, "Panel IO init failed: %s", esp_err_to_name(ret));
        return ret;
    }
    m_io_handle = io_handle;

    // 4. Panel Driver Config (ST7789)
    esp_lcd_panel_dev_config_t panel_cfg = {};
    panel_cfg.reset_gpio_num = LCD_PIN_RST;
    panel_cfg.rgb_ele_order = LCD_RGB_ELEMENT_ORDER_BGR;
    panel_cfg.bits_per_pixel = 16;

    esp_lcd_panel_handle_t panel_handle = nullptr;
    ret = esp_lcd_new_panel_st7789(io_handle, &panel_cfg, &panel_handle);
    if (ret != ESP_OK) {
        ESP_LOGE(TAG, "ST7789 panel init failed: %s", esp_err_to_name(ret));
        return ret;
    }
    m_panel_handle = panel_handle;

    esp_lcd_panel_reset(panel_handle);
    esp_lcd_panel_init(panel_handle);
    esp_lcd_panel_invert_color(panel_handle, true); // ST7789 color inversion
    esp_lcd_panel_swap_xy(panel_handle, true);      // Landscape orientation
    esp_lcd_panel_mirror(panel_handle, false, true); // Mirror X for correct layout
    esp_lcd_panel_set_gap(panel_handle, 0, 34);     // Waveshare 1.47" ST7789 172x320 offset
    esp_lcd_panel_disp_on_off(panel_handle, true);

    // 5. Allocate Framebuffer in Internal SRAM (320 x 172 x 2 = 110 KB)
    m_framebuffer = (uint16_t*)heap_caps_malloc(LCD_WIDTH * LCD_HEIGHT * sizeof(uint16_t), MALLOC_CAP_INTERNAL | MALLOC_CAP_DMA);
    if (!m_framebuffer) {
        ESP_LOGE(TAG, "Failed to allocate 110 KB LCD framebuffer!");
        return ESP_ERR_NO_MEM;
    }

    // Note: WS2812B RGB LED on GPIO 8 is managed by unified Hardware::getStatusLed()
    m_initialized = true;
    clear(COLOR_BLACK);
    drawHeader("    WAVESHARE ESP32-C6 BLE AUDIO");
    flush();

    ESP_LOGI(TAG, "ST7789 1.47-inch LCD Console Initialized Successfully.");
    return ESP_OK;
}

void LcdDisplay::setBacklight(bool enable) {
    setBacklightBrightness(enable ? 20 : 0);
}

void LcdDisplay::setBacklightBrightness(uint8_t percent) {
    if (percent > 100) percent = 100;
    uint32_t duty = (percent * 1023) / 100;
    ledc_set_duty(LEDC_LOW_SPEED_MODE, LEDC_CHANNEL_0, duty);
    ledc_update_duty(LEDC_LOW_SPEED_MODE, LEDC_CHANNEL_0);
}

void LcdDisplay::clear(uint16_t bg_color) {
    if (!m_framebuffer) return;
    for (int i = 0; i < LCD_WIDTH * LCD_HEIGHT; ++i) {
        m_framebuffer[i] = bg_color;
    }
}

void LcdDisplay::drawChar(int x, int y, char c, uint16_t color, uint16_t bg_color) {
    if (c < 32 || c > 126 || !m_framebuffer) return;

    int char_idx = c - 32;
    for (int row = 0; row < 16; ++row) {
        uint8_t line = FONT_8X16[char_idx][row];
        for (int col = 0; col < 8; ++col) {
            uint16_t pixel_color = (line & (0x80 >> col)) ? color : bg_color;
            int px = x + col;
            int py = y + row;
            if (px >= 0 && px < LCD_WIDTH && py >= 0 && py < LCD_HEIGHT) {
                m_framebuffer[py * LCD_WIDTH + px] = pixel_color;
            }
        }
    }
}

void LcdDisplay::drawString(int x, int y, const char* str, uint16_t color, uint16_t bg_color) {
    if (!str) return;
    int cur_x = x;
    while (*str) {
        if (cur_x + 8 > LCD_WIDTH) break;
        drawChar(cur_x, y, *str, color, bg_color);
        cur_x += 8;
        str++;
    }
}

void LcdDisplay::drawHeader(const char* title) {
    if (!m_framebuffer) return;

    // Draw header bar background (White Background / Balck Text)
    for (int y = 0; y < 18; ++y) {
        for (int x = 0; x < LCD_WIDTH; ++x) {
            m_framebuffer[y * LCD_WIDTH + x] = COLOR_WHITE;
        }
    }

    drawString(6, 1, title, COLOR_BLACK, COLOR_WHITE);

    // Header Separator Line
    for (int x = 0; x < LCD_WIDTH; ++x) {
        m_framebuffer[18 * LCD_WIDTH + x] = COLOR_MAGENTA;
        m_framebuffer[19 * LCD_WIDTH + x] = COLOR_MAGENTA;
    }
}

void LcdDisplay::printLine(int row, const char* text, uint16_t color, uint16_t bg_color) {
    if (row < 0 || row > 9 || !m_framebuffer) return;

    int y = 22 + (row * 15); // Calculate row Y coordinate
    if (y + 16 > LCD_HEIGHT) return;

    // Clear existing line background
    for (int py = y; py < y + 15; ++py) {
        for (int px = 0; px < LCD_WIDTH; ++px) {
            m_framebuffer[py * LCD_WIDTH + px] = bg_color;
        }
    }

    drawString(4, y, text, color, bg_color);
}

void LcdDisplay::setRgbColor(uint8_t red, uint8_t green, uint8_t blue) {
    Hardware::getStatusLed().setColor(red, green, blue);
}

void LcdDisplay::flush() {
    if (!m_initialized || !m_panel_handle || !m_framebuffer) return;
    auto* panel = static_cast<esp_lcd_panel_handle_t>(m_panel_handle);
    esp_lcd_panel_draw_bitmap(panel, 0, 0, LCD_WIDTH, LCD_HEIGHT, m_framebuffer);
}

} // namespace Hardware
